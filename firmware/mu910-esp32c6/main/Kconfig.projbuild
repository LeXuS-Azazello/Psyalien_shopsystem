## firmware/mu910-esp32c6/main/Kconfig.projbuild
```kconfig
menu "MU910-M Reader"

config MU910_UART_TX_GPIO
    int "ESP32 TX GPIO connected to MU910-M RXD"
    range 0 48
    default 11

config MU910_UART_RX_GPIO
    int "ESP32 RX GPIO connected to MU910-M TXD"
    range 0 48
    default 10

config MU910_ENABLE_INVENTORY
    bool "Enable RF inventory after module identification"
    default n
    help
        Leave disabled until the antenna frequency band, RF connector path,
        and local regulatory requirements have been confirmed.

config MU910_INVENTORY_DURATION_SEC
    int "Inventory burst duration in seconds"
    depends on MU910_ENABLE_INVENTORY
    range 1 30
    default 5

config MU910_INVENTORY_COOLDOWN_SEC
    int "Cooldown between inventory bursts in seconds"
    depends on MU910_ENABLE_INVENTORY
    range 1 60
    default 5

endmenu
```

## firmware/mu910-esp32c6/sdkconfig.defaults
```kconfig
CONFIG_IDF_TARGET="esp32s3"
CONFIG_ESPTOOLPY_FLASHSIZE="8MB"
CONFIG_ESPTOOLPY_FLASHSIZE_8MB=y
CONFIG_MU910_UART_TX_GPIO=10
CONFIG_MU910_UART_RX_GPIO=11
```

## firmware/mu910-usb-bridge/main/Kconfig.projbuild
```kconfig
menu "MU910 USB UART bridge"

config MU910_UART_TX_GPIO
    int "ESP32 UART TX GPIO connected to MU910 RXD"
    range 0 48
    default 10

config MU910_UART_RX_GPIO
    int "ESP32 UART RX GPIO connected to MU910 TXD"
    range 0 48
    default 11

endmenu
```

## firmware/mu910-usb-bridge/sdkconfig.defaults
```kconfig
CONFIG_IDF_TARGET="esp32s3"
CONFIG_ESPTOOLPY_FLASHSIZE_8MB=y
CONFIG_ESPTOOLPY_FLASHSIZE="8MB"
CONFIG_ESP_CONSOLE_UART_DEFAULT=y
CONFIG_ESP_CONSOLE_UART_NUM=0
CONFIG_ESP_CONSOLE_SECONDARY_NONE=y
CONFIG_MU910_UART_TX_GPIO=10
CONFIG_MU910_UART_RX_GPIO=11
```
